/**
 * @cliArgs --board "/ti/boards/CC26X2R1_LAUNCHXL" --product "simplelink_cc13x2_26x2_sdk@5.20.00.52"
 * @versions {"data":"2021060817","timestamp":"2021060817","tool":"1.8.2+1992","templates":null}
 */

/**
 * Import the modules used in this configuration.
 */
const Display  = scripting.addModule("/ti/display/Display");
const Display1 = Display.addInstance();
const GPIO     = scripting.addModule("/ti/drivers/GPIO", {}, false);
const GPIO1    = GPIO.addInstance();
const GPIO2    = GPIO.addInstance();
const GPIO3    = GPIO.addInstance();
const GPIO4    = GPIO.addInstance();
const GPIO5    = GPIO.addInstance();
const I2C      = scripting.addModule("/ti/drivers/I2C", {}, false);
const I2C1     = I2C.addInstance();
const RTOS     = scripting.addModule("/ti/drivers/RTOS");
const SPI      = scripting.addModule("/ti/drivers/SPI");
const SPI1     = SPI.addInstance();

/**
 * Write custom configuration values to the imported modules.
 */
Display1.$name                    = "CONFIG_Display_0";
Display1.$hardware                = system.deviceData.board.components.XDS110UART;
Display1.uart.$name               = "CONFIG_UART_0";
Display1.uart.txPinInstance.$name = "CONFIG_PIN_0";
Display1.uart.rxPinInstance.$name = "CONFIG_PIN_1";

GPIO1.$name              = "SLAVE_SELECT";
GPIO1.initialOutputState = "High";
GPIO1.mode               = "Output";
GPIO1.gpioPin.$assign    = "boosterpack.27";
GPIO1.pinInstance.$name  = "CONFIG_PIN_2";

GPIO2.$name             = "Btn_1";
GPIO2.$hardware         = system.deviceData.board.components["BTN-1"];
GPIO2.pinInstance.$name = "CONFIG_PIN_3";

GPIO3.$name             = "RESET";
GPIO3.mode              = "Output";
GPIO3.pull              = "Pull Up";
GPIO3.pinInstance.$name = "CONFIG_PIN_9";

GPIO4.$name             = "STBY";
GPIO4.mode              = "Output";
GPIO4.pull              = "Pull Down";
GPIO4.pinInstance.$name = "CONFIG_PIN_10";

GPIO5.$name             = "RTS_TX0";
GPIO5.mode              = "Output";
GPIO5.pinInstance.$name = "CONFIG_PIN_4";

I2C1.$name                = "CONFIG_I2C_ADS_0";
I2C1.i2c.sdaPin.$assign   = "boosterpack.10";
I2C1.i2c.sclPin.$assign   = "boosterpack.9";
I2C1.sdaPinInstance.$name = "CONFIG_PIN_5";
I2C1.clkPinInstance.$name = "CONFIG_PIN_11";

const CCFG              = scripting.addModule("/ti/devices/CCFG", {}, false);
CCFG.ccfgTemplate.$name = "ti_devices_CCFGTemplate0";

SPI1.$name                 = "CONFIG_SPI_MASTER";
SPI1.defaultTxBufferValue  = "0xFF";
SPI1.$hardware             = system.deviceData.board.components.LP_SPI;
SPI1.sclkPinInstance.$name = "CONFIG_PIN_6";
SPI1.misoPinInstance.$name = "CONFIG_PIN_7";
SPI1.mosiPinInstance.$name = "CONFIG_PIN_8";

/**
 * Pinmux solution for unlocked pins/peripherals. This ensures that minor changes to the automatic solver in a future
 * version of the tool will not impact the pinmux you originally saw.  These lines can be completely deleted in order to
 * re-solve from scratch.
 */
Display1.uart.uart.$suggestSolution       = "UART1";
Display1.uart.uart.txPin.$suggestSolution = "boosterpack.4";
Display1.uart.uart.rxPin.$suggestSolution = "boosterpack.3";
GPIO2.gpioPin.$suggestSolution            = "boosterpack.13";
GPIO3.gpioPin.$suggestSolution            = "boosterpack.29";
GPIO4.gpioPin.$suggestSolution            = "boosterpack.30";
GPIO5.gpioPin.$suggestSolution            = "boosterpack.18";
I2C1.i2c.$suggestSolution                 = "I2C0";
SPI1.spi.$suggestSolution                 = "SSI0";
SPI1.spi.sclkPin.$suggestSolution         = "boosterpack.7";
SPI1.spi.misoPin.$suggestSolution         = "boosterpack.14";
SPI1.spi.mosiPin.$suggestSolution         = "boosterpack.15";
SPI1.spi.dmaRxChannel.$suggestSolution    = "DMA_CH3";
SPI1.spi.dmaTxChannel.$suggestSolution    = "DMA_CH4";
