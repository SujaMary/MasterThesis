/**
 * @cliArgs --board "/ti/boards/CC26X2R1_LAUNCHXL" --product "simplelink_cc13x2_26x2_sdk@5.20.00.52"
 * @versions {"data":"2021060817","timestamp":"2021060817","tool":"1.8.2+1992","templates":null}
 */

/**
 * Import the modules used in this configuration.
 */
const ble         = scripting.addModule("/ti/ble5stack/ble");
const CCFG        = scripting.addModule("/ti/devices/CCFG");
const rfdesign    = scripting.addModule("/ti/devices/radioconfig/rfdesign");
const Display     = scripting.addModule("/ti/display/Display");
const Display1    = Display.addInstance();
const Display2    = Display.addInstance();
const AESCCM      = scripting.addModule("/ti/drivers/AESCCM");
const AESCCM1     = AESCCM.addInstance();
const AESCTRDRBG  = scripting.addModule("/ti/drivers/AESCTRDRBG");
const AESCTRDRBG1 = AESCTRDRBG.addInstance();
const AESECB      = scripting.addModule("/ti/drivers/AESECB");
const AESECB1     = AESECB.addInstance();
const ECDH        = scripting.addModule("/ti/drivers/ECDH");
const ECDH1       = ECDH.addInstance();
const GPIO        = scripting.addModule("/ti/drivers/GPIO");
const GPIO1       = GPIO.addInstance();
const GPIO2       = GPIO.addInstance();
const GPIO3       = GPIO.addInstance();
const GPIO4       = GPIO.addInstance();
const GPIO5       = GPIO.addInstance();
const GPIO6       = GPIO.addInstance();
const NVS         = scripting.addModule("/ti/drivers/NVS");
const NVS1        = NVS.addInstance();
const Power       = scripting.addModule("/ti/drivers/Power");
const RF          = scripting.addModule("/ti/drivers/RF");
const RTOS        = scripting.addModule("/ti/drivers/RTOS");
const SPI         = scripting.addModule("/ti/drivers/SPI", {}, false);
const SPI1        = SPI.addInstance();
const SPI2        = SPI.addInstance();
const TRNG        = scripting.addModule("/ti/drivers/TRNG");
const TRNG1       = TRNG.addInstance();

/**
 * Write custom configuration values to the imported modules.
 */
ble.lockProject                                           = true;
ble.radioConfig.codeExportConfig.$name                    = "ti_devices_radioconfig_code_export_param0";
ble.connUpdateParamsPeripheral.$name                      = "ti_ble5stack_general_ble_conn_update_params0";
ble.advSet1.$name                                         = "ti_ble5stack_broadcaster_advertisement_set0";
ble.advSet1.advParam1.$name                               = "ti_ble5stack_broadcaster_advertisement_params0";
ble.advSet1.advData1.$name                                = "ti_ble5stack_broadcaster_advertisement_data0";
ble.advSet1.advData1.GAP_ADTYPE_FLAGS                     = true;
ble.advSet1.advData1.advertisingFlags                     = ["GAP_ADTYPE_FLAGS_BREDR_NOT_SUPPORTED","GAP_ADTYPE_FLAGS_GENERAL"];
ble.advSet1.advData1.GAP_ADTYPE_LOCAL_NAME_SHORT          = true;
ble.advSet1.advData1.shortenedLocalName                   = "SP";
ble.advSet1.advData1.GAP_ADTYPE_16BIT_MORE                = true;
ble.advSet1.advData1.numOfUUIDs16More                     = 1;
ble.advSet1.advData1.UUID016More                          = 0xFFF0;
ble.advSet1.scanRes1.$name                                = "ti_ble5stack_broadcaster_advertisement_data1";
ble.advSet1.scanRes1.GAP_ADTYPE_LOCAL_NAME_COMPLETE       = true;
ble.advSet1.scanRes1.completeLocalName                    = "Simple Peripheral";
ble.advSet1.scanRes1.GAP_ADTYPE_SLAVE_CONN_INTERVAL_RANGE = true;
ble.advSet1.scanRes1.maxConnInterval                      = 130;
ble.advSet1.scanRes1.GAP_ADTYPE_POWER_LEVEL               = true;
ble.advSet2.$name                                         = "ti_ble5stack_broadcaster_advertisement_set1";
ble.advSet2.advParam2.$name                               = "ti_ble5stack_broadcaster_advertisement_params1";
ble.advSet2.advParam2.advType                             = "extended";
ble.advSet2.advData2.$name                                = "ti_ble5stack_broadcaster_advertisement_data2";
ble.advSet2.advData2.GAP_ADTYPE_FLAGS                     = true;
ble.advSet2.advData2.advertisingFlags                     = ["GAP_ADTYPE_FLAGS_BREDR_NOT_SUPPORTED","GAP_ADTYPE_FLAGS_GENERAL"];
ble.advSet2.advData2.GAP_ADTYPE_LOCAL_NAME_SHORT          = true;
ble.advSet2.advData2.shortenedLocalName                   = "SP";
ble.advSet2.advData2.GAP_ADTYPE_16BIT_MORE                = true;
ble.advSet2.advData2.numOfUUIDs16More                     = 1;
ble.advSet2.advData2.UUID016More                          = 0xFFF0;
ble.advSet2.scanRes2.$name                                = "ti_ble5stack_broadcaster_advertisement_data3";
ble.advSet2.scanRes2.GAP_ADTYPE_LOCAL_NAME_COMPLETE       = true;
ble.advSet2.scanRes2.completeLocalName                    = "Simple Peripheral";
ble.advSet2.scanRes2.GAP_ADTYPE_SLAVE_CONN_INTERVAL_RANGE = true;
ble.advSet2.scanRes2.maxConnInterval                      = 130;
ble.advSet2.scanRes2.GAP_ADTYPE_POWER_LEVEL               = true;

CCFG.enableBootloader         = true;
CCFG.enableBootloaderBackdoor = true;
CCFG.dioBootloaderBackdoor    = 13;
CCFG.levelBootloaderBackdoor  = "Active low";
CCFG.ccfgTemplate.$name       = "ti_devices_CCFGTemplate0";

Display1.$name                          = "CONFIG_Display_0";
Display1.$hardware                      = system.deviceData.board.components.XDS110UART;
Display1.uart.$name                     = "CONFIG_UART_0";
Display1.uart.txPinInstance.outputState = "High";
Display1.uart.txPinInstance.$name       = "CONFIG_PIN_UART_TX";
Display1.uart.rxPinInstance.$name       = "CONFIG_PIN_UART_RX";

Display2.$name                       = "CONFIG_Display_1";
Display2.displayType                 = "LCD";
Display2.lcdEnable.$name             = "CONFIG_GPIO_0";
Display2.lcdEnable.gpioPin.$assign   = "boosterpack.5";
Display2.lcdEnable.pinInstance.$name = "CONFIG_PIN_0";
Display2.lcdPower.$name              = "CONFIG_GPIO_1";
Display2.lcdPower.gpioPin.$assign    = "boosterpack.2";
Display2.lcdPower.pinInstance.$name  = "CONFIG_PIN_1";
Display2.lcdSS.$name                 = "CONFIG_GPIO_2";
Display2.lcdSS.gpioPin.$assign       = "boosterpack.6";
Display2.lcdSS.pinInstance.$name     = "CONFIG_PIN_2";

AESCCM1.$name = "CONFIG_AESCCM0";

AESCTRDRBG1.$name              = "CONFIG_AESCTRDRBG_0";
AESCTRDRBG1.aesctrObject.$name = "CONFIG_AESCTR_0";

AESECB1.$name = "CONFIG_AESECB0";

ECDH1.$name = "CONFIG_ECDH0";

GPIO1.$hardware         = system.deviceData.board.components["BTN-1"];
GPIO1.mode              = "Dynamic";
GPIO1.$name             = "CONFIG_GPIO_BTN1";
GPIO1.pinInstance.$name = "CONFIG_PIN_BTN1";

GPIO2.$hardware         = system.deviceData.board.components["BTN-2"];
GPIO2.mode              = "Dynamic";
GPIO2.$name             = "CONFIG_GPIO_BTN2";
GPIO2.pinInstance.$name = "CONFIG_PIN_BTN2";

GPIO3.$name             = "CONFIG_GPIO_LED_0";
GPIO3.$hardware         = system.deviceData.board.components.LED_RED;
GPIO3.pull              = "Pull Down";
GPIO3.pinInstance.$name = "CONFIG_PIN_6";

GPIO4.$name              = "SLAVE_SELECT";
GPIO4.mode               = "Output";
GPIO4.initialOutputState = "High";
GPIO4.gpioPin.$assign    = "boosterpack.27";
GPIO4.pinInstance.$name  = "CONFIG_PIN_7";

GPIO5.$name             = "RESET";
GPIO5.mode              = "Output";
GPIO5.pull              = "Pull Up";
GPIO5.pinInstance.$name = "CONFIG_PIN_8";

GPIO6.$name             = "STBY";
GPIO6.mode              = "Output";
GPIO6.pull              = "Pull Down";
GPIO6.pinInstance.$name = "CONFIG_PIN_9";

NVS1.$name                    = "CONFIG_NVSINTERNAL";
NVS1.internalFlash.$name      = "ti_drivers_nvs_NVSCC26XX0";
NVS1.internalFlash.regionBase = 0x48000;
NVS1.internalFlash.regionSize = 0x4000;

SPI1.$name                 = "CONFIG_SPI_0";
Display2.spi               = SPI1;
SPI1.defaultTxBufferValue  = "0xFF";
SPI1.spi.$assign           = "SSI1";
SPI1.spi.sclkPin.$assign   = "boosterpack.10";
SPI1.spi.misoPin.$assign   = "boosterpack.9";
SPI1.spi.mosiPin.$assign   = "boosterpack.28";
SPI1.sclkPinInstance.$name = "CONFIG_PIN_3";
SPI1.misoPinInstance.$name = "CONFIG_PIN_4";
SPI1.mosiPinInstance.$name = "CONFIG_PIN_5";

SPI2.$name                 = "CONFIG_SPI_MASTER";
SPI2.$hardware             = system.deviceData.board.components.LP_SPI;
SPI2.sclkPinInstance.$name = "CONFIG_PIN_10";
SPI2.misoPinInstance.$name = "CONFIG_PIN_11";
SPI2.mosiPinInstance.$name = "CONFIG_PIN_12";

TRNG1.$name = "CONFIG_TRNG_0";

/**
 * Pinmux solution for unlocked pins/peripherals. This ensures that minor changes to the automatic solver in a future
 * version of the tool will not impact the pinmux you originally saw.  These lines can be completely deleted in order to
 * re-solve from scratch.
 */
Display1.uart.uart.$suggestSolution       = "UART1";
Display1.uart.uart.txPin.$suggestSolution = "boosterpack.4";
Display1.uart.uart.rxPin.$suggestSolution = "boosterpack.3";
GPIO1.gpioPin.$suggestSolution            = "boosterpack.13";
GPIO2.gpioPin.$suggestSolution            = "boosterpack.12";
GPIO3.gpioPin.$suggestSolution            = "boosterpack.39";
GPIO5.gpioPin.$suggestSolution            = "boosterpack.29";
GPIO6.gpioPin.$suggestSolution            = "boosterpack.30";
SPI1.spi.dmaRxChannel.$suggestSolution    = "DMA_CH16";
SPI1.spi.dmaTxChannel.$suggestSolution    = "DMA_CH17";
SPI2.spi.$suggestSolution                 = "SSI0";
SPI2.spi.sclkPin.$suggestSolution         = "boosterpack.7";
SPI2.spi.misoPin.$suggestSolution         = "boosterpack.14";
SPI2.spi.mosiPin.$suggestSolution         = "boosterpack.15";
SPI2.spi.dmaRxChannel.$suggestSolution    = "DMA_CH3";
SPI2.spi.dmaTxChannel.$suggestSolution    = "DMA_CH4";
