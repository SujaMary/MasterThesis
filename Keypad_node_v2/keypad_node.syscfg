/**
 * @cliArgs --board "/ti/boards/CC26X2R1_LAUNCHXL" --product "simplelink_cc13x2_26x2_sdk@5.20.00.52"
 * @versions {"data":"2021060817","timestamp":"2021060817","tool":"1.8.2+1992","templates":null}
 */

/**
 * Import the modules used in this configuration.
 */
const Display  = scripting.addModule("/ti/display/Display");
const Display1 = Display.addInstance();
const GPIO     = scripting.addModule("/ti/drivers/GPIO", {}, false);
const GPIO1    = GPIO.addInstance();
const GPIO2    = GPIO.addInstance();
const GPIO3    = GPIO.addInstance();
const GPIO4    = GPIO.addInstance();
const GPIO5    = GPIO.addInstance();
const GPIO6    = GPIO.addInstance();
const GPIO7    = GPIO.addInstance();
const GPIO8    = GPIO.addInstance();
const GPIO9    = GPIO.addInstance();
const GPIO10   = GPIO.addInstance();
const GPIO11   = GPIO.addInstance();
const RTOS     = scripting.addModule("/ti/drivers/RTOS");
const SPI      = scripting.addModule("/ti/drivers/SPI");
const SPI1     = SPI.addInstance();

/**
 * Write custom configuration values to the imported modules.
 */
Display1.$name                    = "CONFIG_Display_0";
Display1.$hardware                = system.deviceData.board.components.XDS110UART;
Display1.uart.$name               = "CONFIG_UART_0";
Display1.uart.txPinInstance.$name = "CONFIG_PIN_0";
Display1.uart.rxPinInstance.$name = "CONFIG_PIN_1";

GPIO1.$name              = "SLAVE_SELECT";
GPIO1.initialOutputState = "High";
GPIO1.mode               = "Output";
GPIO1.gpioPin.$assign    = "boosterpack.10";
GPIO1.pinInstance.$name  = "CONFIG_PIN_2";

GPIO2.$name             = "RESET";
GPIO2.mode              = "Output";
GPIO2.pull              = "Pull Up";
GPIO2.gpioPin.$assign   = "boosterpack.18";
GPIO2.pinInstance.$name = "CONFIG_PIN_3";

GPIO3.$name             = "STBY";
GPIO3.mode              = "Output";
GPIO3.pull              = "Pull Down";
GPIO3.gpioPin.$assign   = "boosterpack.19";
GPIO3.pinInstance.$name = "CONFIG_PIN_4";

GPIO4.$name             = "GPIO_COL_1";
GPIO4.mode              = "Output";
GPIO4.pull              = "Pull Up";
GPIO4.gpioPin.$assign   = "boosterpack.23";
GPIO4.pinInstance.$name = "CONFIG_PIN_5";

GPIO5.$name             = "GPIO_COL_2";
GPIO5.mode              = "Output";
GPIO5.pull              = "Pull Up";
GPIO5.gpioPin.$assign   = "boosterpack.24";
GPIO5.pinInstance.$name = "CONFIG_PIN_9";

GPIO6.$name             = "GPIO_COL_3";
GPIO6.mode              = "Output";
GPIO6.pull              = "Pull Up";
GPIO6.gpioPin.$assign   = "boosterpack.25";
GPIO6.pinInstance.$name = "CONFIG_PIN_10";

GPIO7.$name             = "GPIO_COL_4";
GPIO7.mode              = "Output";
GPIO7.pull              = "Pull Up";
GPIO7.gpioPin.$assign   = "boosterpack.26";
GPIO7.pinInstance.$name = "CONFIG_PIN_11";

GPIO8.$name             = "GPIO_ROW_1";
GPIO8.pull              = "Pull Up";
GPIO8.gpioPin.$assign   = "boosterpack.27";
GPIO8.pinInstance.$name = "CONFIG_PIN_12";

GPIO9.$name             = "GPIO_ROW_2";
GPIO9.pull              = "Pull Up";
GPIO9.gpioPin.$assign   = "boosterpack.28";
GPIO9.pinInstance.$name = "CONFIG_PIN_13";

GPIO10.$name             = "GPIO_ROW_3";
GPIO10.pull              = "Pull Up";
GPIO10.pinInstance.$name = "CONFIG_PIN_14";

GPIO11.$name             = "GPIO_ROW_4";
GPIO11.pull              = "Pull Up";
GPIO11.pinInstance.$name = "CONFIG_PIN_15";

const CCFG              = scripting.addModule("/ti/devices/CCFG", {}, false);
CCFG.ccfgTemplate.$name = "ti_devices_CCFGTemplate0";

SPI1.$name                 = "CONFIG_SPI_MASTER";
SPI1.defaultTxBufferValue  = "0xFF";
SPI1.$hardware             = system.deviceData.board.components.LP_SPI;
SPI1.sclkPinInstance.$name = "CONFIG_PIN_6";
SPI1.misoPinInstance.$name = "CONFIG_PIN_7";
SPI1.mosiPinInstance.$name = "CONFIG_PIN_8";

/**
 * Pinmux solution for unlocked pins/peripherals. This ensures that minor changes to the automatic solver in a future
 * version of the tool will not impact the pinmux you originally saw.  These lines can be completely deleted in order to
 * re-solve from scratch.
 */
Display1.uart.uart.$suggestSolution       = "UART1";
Display1.uart.uart.txPin.$suggestSolution = "boosterpack.4";
Display1.uart.uart.rxPin.$suggestSolution = "boosterpack.3";
GPIO10.gpioPin.$suggestSolution           = "boosterpack.29";
GPIO11.gpioPin.$suggestSolution           = "boosterpack.30";
SPI1.spi.$suggestSolution                 = "SSI0";
SPI1.spi.sclkPin.$suggestSolution         = "boosterpack.7";
SPI1.spi.misoPin.$suggestSolution         = "boosterpack.14";
SPI1.spi.mosiPin.$suggestSolution         = "boosterpack.15";
SPI1.spi.dmaRxChannel.$suggestSolution    = "DMA_CH3";
SPI1.spi.dmaTxChannel.$suggestSolution    = "DMA_CH4";
